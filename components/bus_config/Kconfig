## components/bus_config/Kconfig
```kconfig
menu "I2C Bus Configuration"
    menu "Sensor Bus Configuration"
        config BUS0_I2C_MASTER_SDA_IO
            int "SDA Pin"
            default 21
        config BUS0_I2C_MASTER_SCL_IO
            int "SCL Pin"
            default 22
        config BUS0_I2C_MASTER_FREQ_HZ
            int "Bus Speed (Hz)"
            default 400000

    endmenu

    menu "Actuator Bus Configuration"
        config BUS1_I2C_MASTER_SDA_IO
            int "SDA Pin"
            default 17
        config BUS1_I2C_MASTER_SCL_IO
            int "SCL Pin"
            default 16
        config BUS1_I2C_MASTER_FREQ_HZ
            int "Bus Speed (Hz)"
            default 400000
    endmenu
endmenu
```

## components/copter/Kconfig
```kconfig
menu "Copter Configuration"
    choice
        prompt "Select Copter Configuration"
        default HEXACOPTER
        config HEXACOPTER
            bool "Hexacopter Configuration"
        config QUADCOPTER
            bool "Quadcopter Configuration"
    endchoice

    if HEXACOPTER
        menu "Hexacopter Motor Channel Configuration"
            config M1
                int "Motor 1"
                default 0
            config M2
                int "Motor 2"
                default 1
            config M3
                int "Motor 3"
                default 2
            config M4
                int "Motor 4"
                default 3
            config M5
                int "Motor 5"
                    default 4
            config M6
                int "Motor 6"
                default 5
        endmenu
    endif

    if QUADCOPTER
        menu "Quadcopter Motor Channel Configuration"
            config M1
                int "Motor 1"
                default 0
            config M2
                int "Motor 2"
                default 1
            config M3
                int "Motor 3"
                default 2
            config M4
                int "Motor 4"
                default 3
        endmenu
    endif

endmenu
```

## components/esc/Kconfig
```kconfig
menu "ESC PWM Configuration"
    	menu "ESC Configuration Options"
        config ESC_MIN_VALUE
            int "Min value"
            default 1050
        config ESC_MAX_VALUE
            int "Max PWM Value"
            default 2000
        config ESC_ARM_VALUE
            int "Arm Value"
            default 1000
        config THROTTLE_MIN_VALUE
            int "Minimum Throttle"
            default 0
        config THROTTLE_MAX_VALUE
            int "Maximum Throttle"
            default 1
        config ROLL_MIN_VALUE
            int "Minimum Roll (Left)"
            default -1
        config ROLL_MAX_VALUE
            int "Maximum Roll (Right)"
            default 1
        config PITCH_MIN_VALUE
            int "Minimum Pitch (Upward)"
            default -1
        config PITCH_MAX_VALUE
            int "Maximum Pitch (Downward)"
            default 1
        config YAW_MIN_VALUE
            int "Minimum Yaw (Clockwise)"
            default -1
        config YAW_MAX_VALUE
            int "Maximum Roll (Counter Clockwise)"
            default 1
        endmenu
endmenu
```

## main/Kconfig
```kconfig
menu "Uros-drone Configuration"
    config NODE_NAME
        string "Drone Node Name"
        default "winged_turtle_01"
    
    config NODE_NAMESPACE
        string "Drone Node Namespace"
        default ""
endmenu
```
